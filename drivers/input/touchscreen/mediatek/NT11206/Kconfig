## drivers/input/touchscreen/mediatek/NT11206/Kconfig
```kconfig
#
# Touchscreen driver configuration
#
if TOUCHSCREEN_MTK_NT11206

choice
	default TOUCHSCREEN_NT11206_1080_1920
		prompt "Novatek NT11206 Panels"

config TOUCHSCREEN_NT11206_1080_1920
		bool "NT11206_1080_1920"
		depends on I2C
		help
			Say Y here if you have a Novatek NT11206 Panel
			to the host processor over I2C

			If unsure, say N.
endchoice

endif
```

## drivers/misc/mediatek/magnetometer/akm09918-new/Kconfig
```kconfig
config MTK_AKM09918_NEW
	tristate "AKM09918 for MediaTek package"
	default n
	help
	  It support different magnetometer sensor.
          If this option is set,
	  it will support
          AKMD09918 magnetometer.
```

## drivers/misc/mediatek/nfc/Kconfig
```kconfig
menuconfig MTK_NFC
	tristate "NFC drivers"
	default n
	---help---
	  Say Y here for supporting NFC.
	  Say Y here for supporting NFC.
	  Say Y here for supporting NFC.

if MTK_NFC

config NFC_MT6605 # MTK_NFC
	tristate "MediaTek NFC driver"
	default n
	help
	  Y means NFC_MT6605 define if use Mediatek NFC Function to provide reader
	  Card emulation or P2P function. If you are not sure about this, set n.
	  Y means NFC_MT6605 define if use Mediatek NFC Function to provide reader
	  Card emulation or P2P function. If you are not sure about this, set n.

config NFC_MSR3110
	tristate "MSR3110 NFC driver"
	default n
	help
	  Y means NFC_MSR3110 define if use MSTAR NFC Function to provide reader
	  Card emulation or P2P function. If you are not sure about this, set n.

endif # NFC
# [NFC][Kent][16090701][begin] Proting NFC PN553 
menuconfig ARIMA_NFC
	tristate "NXP NFC drivers"
	default n
	---help---
	  Say Y here for supporting NFC.
#jack
if ARIMA_NFC
config PN553_NFC 
	tristate "NXP PN553 NFC driver"
	default n
endif
# [NFC][Kent][16090701][begin] Proting NFC PN553 
```

## drivers/misc/mediatek/step_counter/Kconfig
```kconfig
config CUSTOM_KERNEL_STEP_COUNTER
	bool "CUSTOM_KERNEL_STEP_COUNTER"
	help
	  A step counter is a device, usually portable and electronic or electromechanical,
	  that counts each step a person takes by detecting the motion of the person's hands or hips.


config CUSTOM_KERNEL_SIGNIFICANT_MOTION
	bool "CUSTOM_KERNEL_SIGNIFICANT_MOTION"
	help
	  Kernel space sigificant motion sensor driver.
source "drivers/misc/mediatek/step_counter/stepsignhub/Kconfig"
#[SM31][Sensors][JasonHsing] G-sensor bma422 driver porting 20161012 --
source "drivers/misc/mediatek/step_counter/bma4xy_stc/Kconfig"
```

## drivers/misc/mediatek/step_counter/bma4xy_stc/Kconfig
```kconfig
config MTK_BMA4XYSTC
        bool "BMA4XY for MediaTek package"
        default n
        help
        It support different step counter sensor.
        If this option is set,
	  	it will support
         BMA4XY step counter.
```
